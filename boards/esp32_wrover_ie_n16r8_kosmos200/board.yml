## boards/esp32_wrover_ie_n16r8_kosmos200/board.yml
```yaml
board:
  name: esp32_wrover_ie_n16r8_kosmos200
  vendor: espressif
  socs:
    - name: esp32
```

## boards/espressif/esp32_wrover_ie_n16r8_kosmos200/Kconfig.kosmos200
```kconfig
# ESP-WROVER-KIT board configuration

# Copyright (c) 2021 Espressif Systems (Shanghai) Co., Ltd.
# SPDX-License-Identifier: Apache-2.0

config BOARD_ESP_KOSMOS200
	select SOC_ESP32_WROVER_E_N16R8
	#seems we have to disable SOC_ESP32_PROCPU because our PSRAM is 8MB
	select SOC_ESP32_PROCPU
	#TODO: no se si habilitar esto
	#select SOC_ESP32_APPCPU
```

## boards/hubelectronics/kosmos200/Kconfig.kosmos200
```kconfig
# Copyright (c) 2023 Espressif Systems (Shanghai) Co., Ltd.
# SPDX-License-Identifier: Apache-2.0

config BOARD_KOSMOS200
	select SOC_ESP32_WROVER_E_N16R8
	select SOC_ESP32_PROCPU if BOARD_KOSMOS200_ESP32_PROCPU
	select SOC_ESP32_APPCPU if BOARD_KOSMOS200_ESP32_APPCPU
```

## dts/bindings/hubelectronics,led_simple.yaml
```yaml
# Copyright (c) 2024 HUB Electronics Hardware Engineering SL

description: LED_SIMPLE

compatible: "hubelectronics,led-simple"

properties:

  enable-gpios:
    type: phandle-array
    required: true
    description:
      GPIOs for enabling leds.
```

## west.yml
```yaml
# Copyright (c) 2021 Nordic Semiconductor ASA
# SPDX-License-Identifier: Apache-2.0

manifest:
  self:
    path: example-application

  remotes:
    - name: zephyrproject-rtos
      url-base: https://github.com/zephyrproject-rtos

  projects:
    - name: zephyr
      remote: zephyrproject-rtos
      revision: 4793e00ae803ae6b7948e4c110f7ceef11821ef5
      import: true
```
