## Kconfig
```
# Copyright (c) 2021 Nordic Semiconductor ASA
# SPDX-License-Identifier: Apache-2.0
#
# This file is the application Kconfig entry point. All application Kconfig
# options can be defined here or included via other application Kconfig files.
# You can browse these options using the west targets menuconfig (terminal) or
# guiconfig (GUI).

menu "Zephyr"
source "Kconfig.zephyr"
source "../hubelectronics-library/Kconfig"
endmenu

module = APP
module-str = APP
source "subsys/logging/Kconfig.template.log_config"
```

## prj.conf
```kconfig
# Copyright (c) 2021 Nordic Semiconductor ASA
# SPDX-License-Identifier: Apache-2.0
#
# This file contains selected Kconfig options for the application.


#CPP support
CONFIG_CPP=y
CONFIG_REQUIRES_FULL_LIBCPP=y

#hubelectronics-library CONFIGs, if we want to include a module in our project we have to add it here
CONFIG_LED_SIMPLE_ENABLE=y
CONFIG_COMMON_HUBELECTRONICS_LIBRARY_ENABLE=y
```

## src/main.cpp
```c
/*
 * Copyright (c) 2021 Nordic Semiconductor ASA
 * SPDX-License-Identifier: Apache-2.0
 */

#include <zephyr/kernel.h>
#include <zephyr/logging/log.h>

#include "../../application/kosmos200.hpp"

LOG_MODULE_REGISTER(main, CONFIG_APP_LOG_LEVEL);

Kosmos200 *kosmos200;

int main() {
  kosmos200 = new Kosmos200();
  //pcontroller->start();
  delete kosmos200;
  return 0;
}
```
